## conf/layer.conf
```bitbake
# We have a conf and classes directory, add to BBPATH
BBPATH .= ":${LAYERDIR}"

# We have recipes-* directories, add to BBFILES
BBFILES += "${LAYERDIR}/recipes-*/*/*.bb \
            ${LAYERDIR}/recipes-*/*/*.bbappend"

BBFILE_COLLECTIONS += "meta-phycade"
BBFILE_PATTERN_meta-phycade = "^${LAYERDIR}/"
BBFILE_PRIORITY_meta-phycade = "6"

LAYERDEPENDS_meta-phycade = "core"
LAYERSERIES_COMPAT_meta-phycade = "kirkstone"
```
